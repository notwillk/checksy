## products/rulesyos/br2-external/Config.in
```kconfig
menu "RulesyOS"

source "$BR2_EXTERNAL_RULESYOS_PATH/package/rulesy/Config.in"
source "$BR2_EXTERNAL_RULESYOS_PATH/package/rulesyos-stage0/Config.in"

endmenu
```

## products/rulesyos/br2-external/configs/rulesyos_qemu_x86_64_defconfig
```kconfig
BR2_x86_64=y
BR2_TOOLCHAIN_BUILDROOT_GLIBC=y
BR2_PACKAGE_HOST_LINUX_HEADERS_CUSTOM_6_12=y
BR2_GLOBAL_PATCH_DIR="board/qemu/patches"
BR2_DOWNLOAD_FORCE_CHECK_HASHES=y
BR2_STRIP_EXCLUDE_FILES="rulesy"
# BR2_TARGET_ENABLE_ROOT_LOGIN is not set
# BR2_TARGET_GENERIC_GETTY is not set
# BR2_TARGET_GENERIC_REMOUNT_ROOTFS_RW is not set
BR2_ROOTFS_OVERLAY="$(BR2_EXTERNAL_RULESYOS_PATH)/board/rulesyos/qemu_x86_64/rootfs-overlay"
BR2_ROOTFS_POST_BUILD_SCRIPT="$(BR2_EXTERNAL_RULESYOS_PATH)/board/rulesyos/qemu_x86_64/post-build.sh"
BR2_ROOTFS_POST_IMAGE_SCRIPT="$(BR2_EXTERNAL_RULESYOS_PATH)/board/rulesyos/qemu_x86_64/post-image.sh"
BR2_LINUX_KERNEL=y
BR2_LINUX_KERNEL_CUSTOM_VERSION=y
BR2_LINUX_KERNEL_CUSTOM_VERSION_VALUE="6.12.27"
BR2_LINUX_KERNEL_USE_CUSTOM_CONFIG=y
BR2_LINUX_KERNEL_CUSTOM_CONFIG_FILE="board/qemu/x86_64/linux.config"
BR2_LINUX_KERNEL_NEEDS_HOST_LIBELF=y
BR2_PACKAGE_BUSYBOX_SHOW_OTHERS=y
BR2_PACKAGE_BASH=y
# BR2_PACKAGE_URANDOM_SCRIPTS is not set
BR2_PACKAGE_RULESY=y
BR2_PACKAGE_RULESYOS_STAGE0=y
BR2_TARGET_ROOTFS_EXT2=y
# BR2_TARGET_ROOTFS_TAR is not set
BR2_PACKAGE_HOST_GENIMAGE=y
```

## products/rulesyos/br2-external/package/rulesy/Config.in
```kconfig
config BR2_PACKAGE_RULESY
	bool "rulesy"
	depends on BR2_x86_64
	select BR2_PACKAGE_BASH
	help
	  Install the immutable Rulesy release pinned by RulesyOS.

	  https://github.com/notwillk/rulesy
```

## products/rulesyos/br2-external/package/rulesyos-stage0/Config.in
```kconfig
config BR2_PACKAGE_RULESYOS_STAGE0
	bool "rulesyos-stage0"
	depends on BR2_PACKAGE_HOST_RUSTC_TARGET_ARCH_SUPPORTS
	select BR2_PACKAGE_HOST_RUSTC
	help
	  RulesyOS stage-zero boot orchestrator.
```
